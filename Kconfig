## dts/bindings/layered-queue/zephyr,lq-adc-source.yaml
```yaml
# Copyright (c) 2026 Layered Queue Driver
# SPDX-License-Identifier: Apache-2.0

description: |
  Layered Queue ADC Source - Reads ADC values and pushes them to an output queue
  with range validation and status classification.

compatible: "zephyr,lq-adc-source"

properties:
  adc:
    type: phandle
    required: true
    description: Reference to the ADC device

  channel:
    type: int
    required: true
    description: ADC channel number to read from

  output-queue:
    type: phandle
    required: true
    description: Reference to the output queue where samples will be pushed

  poll-interval-ms:
    type: int
    default: 100
    description: Polling interval in milliseconds

  averaging:
    type: int
    default: 1
    description: Number of samples to average before pushing to queue

child-binding:
  description: Expected range definitions for value classification

  properties:
    label:
      type: string
      description: Range label (e.g., "valid", "degraded", "fault")

    min:
      type: int
      required: true
      description: Minimum value (inclusive) for this range

    max:
      type: int
      required: true
      description: Maximum value (inclusive) for this range

    status:
      type: int
      required: true
      description: Status code to assign when value falls in this range
      enum:
        - 0  # LQ_OK
        - 1  # LQ_DEGRADED
        - 2  # LQ_OUT_OF_RANGE
        - 3  # LQ_ERROR
```

## dts/bindings/layered-queue/zephyr,lq-dual-inverted.yaml
```yaml
# Copyright (c) 2026 Layered Queue Driver
# SPDX-License-Identifier: Apache-2.0

description: |
  Layered Queue Dual-Inverted Input - Specialized hardware driver for dual
  redundant inputs where one signal is inverted. Used in safety-critical systems
  where two signals should be complementary (e.g., open/closed, true/false).

compatible: "zephyr,lq-dual-inverted"

properties:
  gpio-normal:
    type: phandle
    required: true
    description: GPIO reference for the normal (non-inverted) signal

  gpio-inverted:
    type: phandle
    required: true
    description: GPIO reference for the inverted signal

  output-queue:
    type: phandle
    required: true
    description: Reference to the output queue for state/error reporting

  poll-interval-ms:
    type: int
    default: 50
    description: Polling interval in milliseconds

  debounce-ms:
    type: int
    default: 10
    description: Debounce time to filter glitches

  error-on-both-high:
    type: boolean
    default: true
    description: Report error when both signals are high

  error-on-both-low:
    type: boolean
    default: true
    description: Report error when both signals are low

  error-status:
    type: int
    default: 3
    description: Status code for inconsistent/error states
    enum:
      - 0  # LQ_OK
      - 1  # LQ_DEGRADED
      - 2  # LQ_OUT_OF_RANGE
      - 3  # LQ_ERROR

  ok-status:
    type: int
    default: 0
    description: Status code when signals are consistent
```

## dts/bindings/layered-queue/zephyr,lq-merge-voter.yaml
```yaml
# Copyright (c) 2026 Layered Queue Driver
# SPDX-License-Identifier: Apache-2.0

description: |
  Layered Queue Merge Voter - Reads from multiple input queues and produces
  a merged/voted output. Can perform median voting, averaging, or consensus checks
  for critical redundant systems.

compatible: "zephyr,lq-merge-voter"

properties:
  input-queues:
    type: phandles
    required: true
    description: Array of input queue references to merge/vote

  output-queue:
    type: phandle
    required: true
    description: Reference to the output queue for merged results

  voting-method:
    type: string
    default: "median"
    enum:
      - "median"
      - "average"
      - "min"
      - "max"
      - "majority"
    description: |
      Method for merging multiple input values:
      - median: Use median value (good for outlier rejection)
      - average: Average all inputs
      - min/max: Use minimum or maximum value
      - majority: Require majority consensus within tolerance

  tolerance:
    type: int
    default: 0
    description: Maximum allowed difference between inputs (absolute value)

  status-if-violation:
    type: int
    default: 2
    description: Status code when inputs disagree beyond tolerance
    enum:
      - 0  # LQ_OK
      - 1  # LQ_DEGRADED
      - 2  # LQ_OUT_OF_RANGE
      - 3  # LQ_ERROR

  timeout-ms:
    type: int
    default: 1000
    description: Max time to wait for all inputs before using partial data

child-binding:
  description: Expected range for merged output validation

  properties:
    label:
      type: string
      description: Range label

    min:
      type: int
      required: true
      description: Minimum acceptable value for merged output

    max:
      type: int
      required: true
      description: Maximum acceptable value for merged output

    status-if-violation:
      type: int
      required: true
      description: Status if merged value violates this range
```

## Kconfig
```kconfig
# Copyright (c) 2026 Layered Queue Driver
# SPDX-License-Identifier: Apache-2.0

menuconfig LQ_DRIVER
	bool "Layered Queue Driver"
	help
	  Enable the Layered Queue Driver framework for building
	  robust data pipelines in safety-critical embedded systems.

if LQ_DRIVER

config LQ_MAX_SIGNALS
	int "Maximum number of signals"
	default 32
	range 1 256
	help
	  Maximum number of signals that can be maintained by the engine.
	  Each signal represents a canonical value from a sensor or merged source.
	  Increase this if you have many sensors or merged values.

config LQ_MAX_CYCLIC_OUTPUTS
	int "Maximum number of cyclic outputs"
	default 16
	range 1 128
	help
	  Maximum number of cyclic (deadline-scheduled) outputs.
	  Each cyclic output periodically transmits a signal value.
	  Examples: J1939 messages, periodic CAN frames, etc.

config LQ_MAX_OUTPUT_EVENTS
	int "Output event buffer size"
	default 64
	range 8 256
	help
	  Size of the output event buffer used during engine step.
	  Should be large enough to hold all events generated in one cycle.
	  Typical: (num_cyclic_outputs + num_on_change_outputs) * 2

config LQ_MAX_MERGES
	int "Maximum number of merge/voter contexts"
	default 8
	range 1 64
	help
	  Maximum number of merge/voter contexts for redundancy management.
	  Each merge combines multiple redundant inputs using voting algorithms.

config LQ_HW_RINGBUFFER_SIZE
	int "Hardware input ringbuffer size"
	default 128
	range 16 512
	help
	  Size of the ringbuffer used to collect raw hardware samples
	  from ISRs and polling functions before processing.
	  Should be large enough to handle burst traffic between engine steps.

config LQ_LOG_LEVEL
	int "Logging level"
	default 3
	range 0 4
	help
	  0 = No logging
	  1 = Errors only
	  2 = Warnings and errors
	  3 = Info, warnings, and errors
	  4 = Debug (all messages)

config LQ_ENGINE_TASK
	bool "Enable automatic engine task"
	default n
	help
	  Automatically create and run the engine processing task.
	  If disabled, you must manually call lq_engine_step() from your code.

if LQ_ENGINE_TASK

choice LQ_ENGINE_TASK_TYPE
	prompt "Engine task implementation"
	default LQ_ENGINE_TASK_ZEPHYR if ZEPHYR_KERNEL
	default LQ_ENGINE_TASK_PTHREAD
	help
	  Select the engine task implementation based on platform.

config LQ_ENGINE_TASK_ZEPHYR
	bool "Zephyr thread"
	depends on ZEPHYR_KERNEL
	help
	  Use Zephyr k_thread for engine processing.

config LQ_ENGINE_TASK_PTHREAD
	bool "POSIX pthread"
	help
	  Use POSIX pthread for engine processing (Linux, macOS, etc).

config LQ_ENGINE_TASK_BARE_METAL
	bool "Bare metal loop"
	help
	  Simple forever loop for bare metal systems.
	  Call lq_engine_task_run() from main().

endchoice

config LQ_ENGINE_TASK_PRIORITY
	int "Engine task priority"
	default 5
	range 0 31
	help
	  Priority for the engine processing task.
	  Lower values = higher priority in Zephyr.

config LQ_ENGINE_TASK_STACK_SIZE
	int "Engine task stack size (bytes)"
	default 2048
	range 512 8192
	help
	  Stack size for the engine processing task.

config LQ_ENGINE_CYCLE_TIME_US
	int "Engine cycle time (microseconds)"
	default 100
	range 10 100000
	help
	  Time between engine processing cycles.
	  Default 100us = 10kHz processing rate.
	  Lower values = faster response, higher CPU usage.

endif # LQ_ENGINE_TASK

endif # LQ_DRIVER
```

## drivers/layered_queue/Kconfig
```kconfig
# Copyright (c) 2026 Layered Queue Driver
# SPDX-License-Identifier: Apache-2.0

menuconfig LQ_DRIVER
    bool "Layered Queue Driver Support"
    help
      Enable support for layered queue drivers that provide
      declarative data pipelines with range validation, redundancy,
      and fault detection.

if LQ_DRIVER

module = LQ
module-str = layered_queue
source "subsys/logging/Kconfig.template.log_config"

config LQ_QUEUE
    bool "Queue Driver"
    default y
    help
      Enable the basic queue driver for buffering data items.

config LQ_ADC_SOURCE
    bool "ADC Source Driver"
    depends on ADC
    help
      Enable ADC source driver for reading analog inputs
      with range validation.

config LQ_SPI_SOURCE
    bool "SPI Source Driver"
    depends on SPI
    help
      Enable SPI source driver for reading digital sensors
      with expected value validation.

config LQ_MERGE_VOTER
    bool "Merge/Voter Driver"
    help
      Enable merge and voting driver for redundant inputs.

config LQ_DUAL_INVERTED
    bool "Dual-Inverted Input Driver"
    depends on GPIO
    help
      Enable dual-inverted input driver for complementary
      safety signals.

config LQ_PROTOCOL_J1939
    bool "J1939 Protocol Driver"
    help
      Enable J1939 protocol driver for SAE J1939 CAN networks.
      Supports PGN-based messaging with cyclic transmission.

config LQ_PROTOCOL_CANOPEN
    bool "CANopen Protocol Driver"
    help
      Enable CANopen protocol driver (DS-301).
      Supports PDO, NMT, Heartbeat, and Emergency messages.

config LQ_INIT_PRIORITY
    int "Layered Queue initialization priority"
    default 80
    help
      Initialization priority for layered queue infrastructure.

endif # LQ_DRIVER
```

## dts/bindings/layered-queue/lq,config-framework.yaml
```yaml
# Copyright (c) 2026 Layered Queue Driver
# SPDX-License-Identifier: Apache-2.0

description: |
  Configuration Framework - Runtime parameter access via UDS
  
  Provides runtime configuration access to remap and scale driver
  parameters through UDS Data Identifiers (DIDs).
  
  Features:
  - Read/write remap configurations (signal mapping, inversion, deadzone)
  - Read/write scale configurations (linear transform, clamping)
  - Calibration mode for secure parameter modification
  - Version tracking for change detection
  - Signal value/status monitoring
  
  Integrated with UDS server for diagnostic protocol access.
  Requires security level 2+ and calibration mode for writes.

compatible: "lq,config-framework"

properties:
  uds-server:
    type: phandle
    required: true
    description: |
      Reference to UDS server node.
      Config framework registers DID handlers with this server.

  max-remaps:
    type: int
    default: 16
    description: |
      Maximum number of remap configurations.
      Each remap consumes ~8 bytes of RAM.

  max-scales:
    type: int
    default: 16
    description: |
      Maximum number of scale configurations.
      Each scale consumes ~24 bytes of RAM.

  calibration-mode-default:
    type: boolean
    default: false
    description: |
      Start in calibration mode (unlocked).
      WARNING: Only for development! Production should be locked.

  enable-runtime-add-remove:
    type: boolean
    default: false
    description: |
      Allow adding/removing configurations at runtime.
      If false, only modification of existing configs is allowed.
      This prevents dynamic allocation issues in safety-critical systems.

  config-locked-default:
    type: boolean
    default: true
    description: |
      Lock configuration by default on startup.
      Requires calibration mode routine to unlock.
      Recommended for production.

  version-tracking:
    type: boolean
    default: true
    description: |
      Enable configuration version tracking.
      Version increments on each configuration change.
      Useful for detecting parameter updates across sessions.

child-binding:
  description: |
    Pre-configured remap or scale instances.
    These are initialized at startup.

  properties:
    type:
      type: string
      enum:
        - "remap"
        - "scale"
      required: true
      description: |
        Type of configuration instance.

    input-signal:
      type: int
      required: true
      description: |
        Input signal ID (0-31).

    output-signal:
      type: int
      required: true
      description: |
        Output signal ID (0-31).

    # Remap-specific properties
    invert:
      type: boolean
      default: false
      description: |
        Invert signal (remap only).
        Output = -Input

    deadzone:
      type: int
      default: 0
      description: |
        Deadzone threshold (remap only).
        Changes smaller than this are ignored.

    # Scale-specific properties
    scale-factor:
      type: int
      default: 100
      description: |
        Scale factor (scale only).
        Output = (Input * scale-factor) / 100 + offset
        Example: 150 = 1.5x scaling

    offset:
      type: int
      default: 0
      description: |
        Offset applied after scaling (scale only).

    clamp-min:
      type: int
      description: |
        Minimum output value (scale only).
        If specified, output is clamped to this value.

    clamp-max:
      type: int
      description: |
        Maximum output value (scale only).
        If specified, output is clamped to this value.

    enabled:
      type: boolean
      default: true
      description: |
        Enable this configuration on startup.
```

## dts/bindings/layered-queue/lq,cyclic-output.yaml
```yaml
# Copyright (c) 2026 Layered Queue Driver
# SPDX-License-Identifier: Apache-2.0

description: |
  Cyclic Output - Deadline-based periodic event generation
  
  Generates output events at fixed intervals using deadline scheduling.
  This prevents drift that occurs with period-based scheduling.
  
  Processed during engine phase 5 (cyclic outputs).
  Events are queued to the output event ringbuffer.

compatible: "lq,cyclic-output"

properties:
  source-signal-id:
    type: int
    required: true
    description: |
      Signal ID to read and transmit.
      Typically a merge or validator output.

  output-type:
    type: string
    required: true
    enum: ["can", "j1939", "canopen", "gpio", "uart"]
    description: Target protocol/bus type

  target-id:
    type: int
    required: true
    description: |
      Protocol-specific identifier:
      - CAN: CAN ID
      - J1939: PGN (Parameter Group Number)
      - CANopen: COB-ID
      - GPIO: Pin number
      - UART: Device index

  period-us:
    type: int
    required: true
    description: |
      Period in microseconds between transmissions.
      Examples: 10000 (10ms/100Hz), 100000 (100ms/10Hz), 1000000 (1s/1Hz)

  priority:
    type: int
    default: 7
    description: |
      CAN/J1939 priority (0=highest, 7=lowest).
      Ignored for non-CAN outputs.

  deadline-offset-us:
    type: int
    default: 0
    description: |
      Initial offset for deadline scheduling.
      Allows staggering multiple outputs to avoid bus congestion.
```

## dts/bindings/layered-queue/lq,engine.yaml
```yaml
# Copyright (c) 2026 Layered Queue Driver
# SPDX-License-Identifier: Apache-2.0

description: |
  Layered Queue Engine - root node for complete system configuration
  
  This binding defines the top-level engine structure that contains:
  - Hardware input sources (ISR-safe ringbuffers)
  - Mid-level processing drivers (merges, validators)
  - Output event generators (cyclic, on-change)
  - Signal storage and state
  
  The engine coordinates all 5 phases:
  1. Ingest: Pull samples from hardware inputs
  2. Staleness: Mark old inputs as stale
  3. Merges: Voter/validator processing
  4. Outputs: Generate on-change events
  5. Cyclic: Generate deadline-based periodic outputs

compatible: "lq,engine"

child-binding:
  description: |
    Child nodes define the components of the engine.
    Use labels to reference nodes in other sections.

properties:
  cycle-time-hz:
    type: int
    default: 100
    description: |
      Engine processing cycle frequency in Hz.
      Overrides CONFIG_LQ_ENGINE_CYCLE_TIME_US if specified.

      Common values:
        10 Hz (100ms): Slow, low-priority monitoring
        50 Hz (20ms): Medium-speed control loops
        100 Hz (10ms): Fast control and monitoring (recommended)
        1000 Hz (1ms): High-speed control loops
        10000 Hz (100us): Very high-speed (motor commutation, power electronics)

      Note: Must be compatible with RTOS tick rate and realistic for CPU load.

  cycle-time-us:
    type: int
    description: |
      Alternative: Engine cycle time in microseconds.
      If both cycle-time-hz and cycle-time-us are specified,
      cycle-time-us takes precedence.

      Example: 10000 = 10ms = 100Hz

  max-signals:
    type: int
    default: 32
    description: Maximum number of internal signals (overrides Kconfig)

  max-merges:
    type: int
    default: 8
    description: Maximum number of merge/validator contexts

  max-cyclic-outputs:
    type: int
    default: 16
    description: Maximum number of cyclic output contexts

  max-output-events:
    type: int
    default: 64
    description: Maximum size of output event queue

  init-priority:
    type: int
    default: 85
    description: |
      Device initialization priority for the engine subsystem.
      Must be after all sensor/input devices are initialized.

      Typical priority order:
        50-59: I2C/SPI/CAN bus drivers
        60-69: Sensor drivers (TMP117, BME280, etc.)
        70-79: Application-specific drivers
        80-84: Hardware input layer
        85-89: Engine and processing layer
        90+:   Application tasks
```

## dts/bindings/layered-queue/lq,hw-adc-input.yaml
```yaml
# Copyright (c) 2026 Layered Queue Driver
# SPDX-License-Identifier: Apache-2.0

description: |
  Hardware Input Source - ADC channel with ISR-safe ringbuffer
  
  Represents a single ADC channel that generates interrupts.
  An ISR handler will be auto-generated that:
  - Reads the ADC value
  - Calls lq_hw_push() to insert into ringbuffer
  - Wakes the engine task

compatible: "lq,hw-adc-input"

properties:
  signal-id:
    type: int
    required: false
    description: |
      (v1.x - DEPRECATED) Signal ID in the engine's signal array.
      In v2.0, signal IDs are auto-assigned in node definition order.
      Only specify this for backward compatibility.

  io-channels:
    type: phandle-array
    description: |
      (v2.0 - PREFERRED) ADC controller and channel using standard Zephyr binding.
      Format: <&adc_controller channel_number>
      Example: io-channels = <&adc0 2>;
      
      This follows the standard Zephyr io-channels specification.

  adc-channel:
    type: int
    description: |
      (v1.x - DEPRECATED) ADC channel number.
      Use io-channels property instead for v2.0.

  adc-device:
    type: phandle
    description: |
      (v1.x - DEPRECATED) Reference to the ADC device node.
      Use io-channels property instead for v2.0.

  isr-priority:
    type: int
    default: 5
    description: Interrupt priority for this ADC channel

  min-raw:
    type: int
    default: 0
    description: Minimum raw ADC value (for validation)

  max-raw:
    type: int
    default: 4095
    description: Maximum raw ADC value (for validation)

  stale-us:
    type: int
    default: 100000
    description: |
      Staleness timeout in microseconds.
      If no new sample arrives within this time, signal is marked stale.

  init-priority:
    type: int
    default: 80
    description: |
      Device initialization priority.
      Must be > ADC device priority.
      Typical: 80 (after ADC at 60-70)
```

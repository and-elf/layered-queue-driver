## dts/bindings/layered-queue/lq,hw-sensor-input.yaml
```yaml
# Copyright (c) 2026 Layered Queue Driver
# SPDX-License-Identifier: Apache-2.0

description: |
  Hardware Input Source - Zephyr Sensor Device
  
  Represents a Zephyr sensor driver (using the sensor API).
  Examples: TMP117, BME280, LSM6DSL, ICP10125, etc.
  
  An ISR handler or polling callback will be auto-generated that:
  - Fetches sensor data via sensor_sample_fetch() / sensor_channel_get()
  - Converts to int32_t
  - Calls lq_hw_push() to insert into ringbuffer
  
  This is preferred over raw ADC/SPI for sensors with Zephyr drivers.

compatible: "lq,hw-sensor-input"

properties:
  signal-id:
    type: int
    required: true
    description: |
      Signal ID in the engine's signal array.
      This is where ingested samples will be stored.

  sensor-device:
    type: phandle
    required: true
    description: |
      Reference to the sensor device node.
      Must be a Zephyr sensor driver (compatible with sensor API).
      
      Examples:
        sensor-device = <&tmp117>;
        sensor-device = <&bme280>;
        sensor-device = <&lsm6dsl>;

  sensor-channel:
    type: int
    required: true
    description: |
      Sensor channel to read (from sensor.h enum).
      
      Common values:
        SENSOR_CHAN_AMBIENT_TEMP = 0
        SENSOR_CHAN_PRESS = 1
        SENSOR_CHAN_ACCEL_XYZ = 10
        SENSOR_CHAN_GYRO_XYZ = 13
        SENSOR_CHAN_RPM = 26

  trigger-type:
    type: string
    default: "data-ready"
    enum: ["data-ready", "threshold", "delta", "poll"]
    description: |
      How to trigger sampling:
      - "data-ready": Use sensor's data-ready interrupt (fastest)
      - "threshold": Trigger on threshold crossing
      - "delta": Trigger on value change > delta
      - "poll": Software polling at fixed interval

  poll-interval-ms:
    type: int
    description: |
      Polling interval in milliseconds (only for trigger-type = "poll").
      Ignored for interrupt-driven triggers.

  scale-factor:
    type: int
    default: 1000
    description: |
      Scale factor for converting sensor value to int32_t.
      
      Example: For temperature in °C with 0.01°C precision:
        scale-factor = 100 (stores 2550 for 25.50°C)
      
      For RPM with 1 RPM precision:
        scale-factor = 1

  offset:
    type: int
    default: 0
    description: |
      Offset to add after scaling.
      Useful for converting units or biasing values.

  stale-us:
    type: int
    default: 100000
    description: |
      Staleness timeout in microseconds.
      If no new sample arrives within this time, signal is marked stale.

  init-priority:
    type: int
    default: 80
    description: |
      Device initialization priority.
      Must be > sensor device priority to ensure sensor is ready.
      
      Typical Zephyr priorities:
        50-59: I2C/SPI bus drivers
        60-69: Sensor drivers
        70-79: Application drivers
        80-89: Application (our layer)
```

## dts/bindings/layered-queue/lq,hw-spi-input.yaml
```yaml
# Copyright (c) 2026 Layered Queue Driver
# SPDX-License-Identifier: Apache-2.0

description: |
  Hardware Input Source - SPI sensor with ISR-safe ringbuffer
  
  Represents a SPI device that generates data-ready interrupts.
  An ISR handler will be auto-generated that:
  - Reads the SPI sensor data
  - Calls lq_hw_push() to insert into ringbuffer
  - Wakes the engine task

compatible: "lq,hw-spi-input"

properties:
  signal-id:
    type: int
    required: true
    description: |
      Signal ID in the engine's signal array.
      This is where ingested samples will be stored.

  spi-device:
    type: phandle
    required: true
    description: Reference to the SPI device node

  data-ready-gpio:
    type: phandle
    description: |
      GPIO pin for data-ready interrupt.
      If specified, ISR will be configured on this GPIO.

  isr-priority:
    type: int
    default: 5
    description: Interrupt priority for data-ready signal

  num-bytes:
    type: int
    default: 2
    enum: [1, 2, 4]
    description: Number of bytes to read from SPI (1, 2, or 4)

  signed:
    type: boolean
    description: If true, interpret value as signed integer

  stale-us:
    type: int
    default: 100000
    description: |
      Staleness timeout in microseconds.
      If no new sample arrives within this time, signal is marked stale.

  init-priority:
    type: int
    default: 80
    description: |
      Device initialization priority.
      Must be > SPI device priority.
      Typical: 80 (after SPI at 50-60)
```

## dts/bindings/layered-queue/lq,input.yaml
```yaml
# Copyright (c) 2026 Layered Queue Driver
# SPDX-License-Identifier: Apache-2.0

description: |
  Generic Input Wrapper - Hardware Abstraction Layer

  Wraps any hardware input source (ADC, SPI, sensor, GPIO) into a
  uniform signal source for the layered queue engine.

  This is the v2.0 API that replaces direct use of lq,hw-*-input nodes.
  Instead of directly specifying hardware parameters, you reference
  an existing hardware source via phandle.

  Benefits:
  - Hardware independence: Change hardware source without changing logic
  - Reusability: Multiple inputs can reference the same hardware
  - Cleaner separation: Hardware config vs signal routing

  Example (v2.0 - new API):
    adc1: adc@40012000 {
      compatible = "st,stm32-adc";
      ...
    };

    speed_input: lq-input {
      compatible = "lq,input";
      input = <&adc1 1>;  /* ADC1 channel 1 */
      stale-us = <100000>;
    };

  Example (v1.x - old API for comparison):
    speed_input: lq-hw-adc-input {
      compatible = "lq,hw-adc-input";
      io-channels = <&adc1 1>;
      max-raw = <4095>;
      min-raw = <0>;
      stale-us = <100000>;
    };

compatible: "lq,input"

properties:
  input:
    type: phandle-array
    required: true
    description: |
      Reference to hardware input source.

      Format depends on the hardware type:
      - ADC: <&adc_controller channel_number>
        Example: input = <&adc0 2>;

      - Sensor: <&sensor_device channel_id>
        Example: input = <&tmp117 SENSOR_CHAN_AMBIENT_TEMP>;

      - SPI: <&spi_device>
        Example: input = <&pressure_sensor>;

      - GPIO: <&gpio_controller pin_number flags>
        Example: input = <&gpio0 15 GPIO_ACTIVE_HIGH>;

      The code generator will detect the hardware type and generate
      appropriate ISR handlers and initialization code.

  stale-us:
    type: int
    default: 100000
    description: |
      Staleness timeout in microseconds.
      If no new sample arrives within this time, signal is marked stale.

  init-priority:
    type: int
    default: 80
    description: |
      Device initialization priority.
      Must be > hardware device priority to ensure hardware is ready.
```

## dts/bindings/layered-queue/lq,mid-merge.yaml
```yaml
# Copyright (c) 2026 Layered Queue Driver
# SPDX-License-Identifier: Apache-2.0

description: |
  Mid-Level Merge Driver - Multi-input voter with redundancy
  
  Combines multiple input signals using a voting algorithm.
  Processes during engine phase 3 (merges).
  
  Voting methods:
  - median: Use median value (default, best for 3+ sensors)
  - average: Average all inputs (smooth but sensitive to outliers)
  - min: Minimum value (conservative)
  - max: Maximum value (aggressive)

compatible: "lq,mid-merge"

properties:
  sources:
    type: phandles
    description: |
      (v2.0 - PREFERRED) Array of source node phandles to merge.
      Example: sources = <&sensor_a &sensor_b &sensor_c>;
      Must have at least 2 sources for voting to work.

  output-signal-id:
    type: int
    required: false
    description: |
      (v1.x - DEPRECATED) Signal ID where merge result is stored.
      In v2.0, output IDs are auto-assigned.

  input-signal-ids:
    type: array
    required: false
    description: |
      (v1.x - DEPRECATED) Array of input signal IDs to merge.
      Use 'sources' phandle array instead for v2.0.
      All inputs must be valid for merge to succeed.

  voting-method:
    type: string
    default: "median"
    enum: ["median", "average", "min", "max"]
    description: Algorithm used to combine input values

  tolerance:
    type: int
    default: 0
    description: |
      Maximum allowed spread between inputs (after voting).
      If spread > tolerance, status becomes LQ_EVENT_INCONSISTENT.
      Set to 0 to disable tolerance checking.

  stale-us:
    type: int
    default: 0
    description: |
      Staleness timeout for the merged signal.
      If 0, inherits from input staleness.
```

## dts/bindings/layered-queue/lq,output.yaml
```yaml
# Copyright (c) 2026 Layered Queue Driver
# SPDX-License-Identifier: Apache-2.0

description: |
  Generic Output Wrapper - Hardware Abstraction Layer

  Wraps any hardware output destination (CAN, GPIO, PWM, UART) into a
  uniform output sink for the layered queue engine.

  This is the v2.0 API that provides a cleaner abstraction for outputs.
  Instead of directly specifying protocol parameters in output nodes,
  you reference hardware peripherals via phandles.

  Benefits:
  - Hardware independence: Change output hardware without changing logic
  - Reusability: Multiple outputs can share the same hardware
  - Cleaner separation: Hardware config vs signal routing

  Example (v2.0 - new API):
    can0: can@40006400 {
      compatible = "st,stm32-can";
      ...
    };

    speed_output: lq-output {
      compatible = "lq,output";
      output = <&can0>;
      source = <&speed_merge>;
    };

  Example (v1.x - old API for comparison):
    speed_output: lq-cyclic-output {
      compatible = "lq,cyclic-output";
      source = <&speed_merge>;
      output-type = "can";
      target-id = <0x123>;
      period-us = <10000>;
    };

compatible: "lq,output"

properties:
  output:
    type: phandle-array
    required: true
    description: |
      Reference to hardware output destination.

      Format depends on the hardware type:
      - CAN: <&can_controller>
        Example: output = <&can0>;

      - GPIO: <&gpio_controller pin_number flags>
        Example: output = <&gpio0 15 GPIO_ACTIVE_HIGH>;

      - PWM: <&pwm_controller channel_number flags>
        Example: output = <&pwm0 2 PWM_POLARITY_NORMAL>;

      - UART: <&uart_device>
        Example: output = <&uart0>;

      The code generator will detect the hardware type and generate
      appropriate transmission handlers and initialization code.

  source:
    type: phandle
    required: true
    description: |
      Source signal to transmit.
      Example: source = <&merge_result>;
      Typically points to a merge, validator, or processing node output.

  init-priority:
    type: int
    default: 90
    description: |
      Device initialization priority.
      Must be > hardware device priority and > input priority.
```

## dts/bindings/layered-queue/lq,protocol-canopen.yaml
```yaml
# Copyright (c) 2026 Layered Queue Driver
# SPDX-License-Identifier: Apache-2.0

description: |
  CANopen Protocol Driver - CANopen DS-301 protocol support
  
  Implements bidirectional CANopen protocol handling:
  - Decode: Parses incoming PDOs, NMT, SDO to internal signals
  - Encode: Formats internal signals to outgoing PDOs
  
  Supports PDO (Process Data Objects), SDO (Service Data Objects),
  NMT (Network Management), SYNC, and Heartbeat.

compatible: "lq,protocol-canopen"

properties:
  node-id:
    type: int
    required: true
    description: |
      CANopen node ID (1-127).
      0 is reserved for NMT master.

  heartbeat-period-ms:
    type: int
    default: 1000
    description: |
      Heartbeat transmission period in milliseconds.
      0 = heartbeat disabled.
      Typical: 1000ms for normal operation.

  nmt-startup-state:
    type: string
    default: "pre-operational"
    enum: ["pre-operational", "operational", "stopped"]
    description: |
      Initial NMT state on bootup.
      - pre-operational: SDO only, no PDO transmission
      - operational: Full operation with PDO
      - stopped: No communication

child-binding:
  description: PDO (Process Data Object) configurations

  properties:
    pdo-type:
      type: string
      required: true
      enum: ["tpdo1", "tpdo2", "tpdo3", "tpdo4", "rpdo1", "rpdo2", "rpdo3", "rpdo4"]
      description: |
        PDO type and number:
        - tpdo: Transmit PDO (output from this node)
        - rpdo: Receive PDO (input to this node)
        Numbers 1-4 indicate PDO slot.

    cob-id:
      type: int
      required: true
      description: |
        COB-ID for this PDO.
        Default CANopen COB-IDs:
        - TPDO1: 0x180 + node-id
        - TPDO2: 0x280 + node-id
        - TPDO3: 0x380 + node-id
        - TPDO4: 0x480 + node-id
        - RPDO1: 0x200 + node-id
        - RPDO2: 0x300 + node-id
        - RPDO3: 0x400 + node-id
        - RPDO4: 0x500 + node-id

    transmission-type:
      type: int
      default: 254
      description: |
        PDO transmission type:
        - 0: Synchronous, acyclic
        - 1-240: Synchronous, every Nth SYNC
        - 254: Event-driven (manufacturer-specific)
        - 255: Device profile specific

    inhibit-time-100us:
      type: int
      default: 0
      description: |
        Minimum time between transmissions in 100us units.
        Prevents bus flooding on rapid signal changes.
        Example: 10 = 1ms minimum spacing.

    event-timer-ms:
      type: int
      default: 0
      description: |
        Event timer period in milliseconds.
        For event-driven PDOs, max time between transmissions.
        0 = no event timer.

    mappings:
      type: array
      required: true
      description: |
        Array of signal-to-PDO mappings.
        Each mapping specifies:
        - signal-id: Internal signal ID
        - index: Object dictionary index (optional)
        - subindex: Object dictionary subindex (optional)
        - length: Data length in bits (8, 16, 32)
        
        Signals are packed sequentially into PDO data.

  child-binding:
    description: Individual PDO mapping entry

    properties:
      signal-id:
        type: int
        required: true
        description: Internal signal ID for this mapping

      index:
        type: int
        default: 0
        description: Object dictionary index (informational)

      subindex:
        type: int
        default: 0
        description: Object dictionary subindex (informational)

      length:
        type: int
        required: true
        enum: [8, 16, 32]
        description: |
          Data length in bits.
          Common sizes:
          - 8: Boolean, byte values
          - 16: Integers, status words
          - 32: Integers, floats (as int32)
```

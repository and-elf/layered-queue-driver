## dts/bindings/layered-queue/lq-fault-monitor.yaml
```yaml
# SPDX-License-Identifier: Apache-2.0
# Fault monitor binding

description: |
  Fault monitor that checks signal conditions and outputs fault flags.
  
  Monitors a single input signal for various fault conditions:
  - Staleness: Signal hasn't updated within timeout
  - Range: Signal value outside min/max bounds  
  - Status: Signal has FAULT or INCONSISTENT status
  
  When any enabled fault condition is detected, sets the fault output
  signal to the configured fault-level, otherwise 0 (OK).
  
  Optionally can trigger limp-home mode by modifying a scale driver's
  parameters when faults are detected. This provides automatic safety
  degradation without requiring external wake callbacks.

compatible: "lq,fault-monitor"

properties:
  input:
    type: phandle
    description: |
      (v2.0 - PREFERRED) Node phandle to monitor for faults.
      Example: input = <&temp_scaled>;

  input-signal-id:
    type: int
    required: false
    description: |
      (v1.x - DEPRECATED) Signal ID to monitor.
      Use 'input' phandle property instead for v2.0.

  fault-output-signal-id:
    type: int
    required: false
    description: |
      (v1.x - DEPRECATED) Signal ID for fault output (0=OK, 1=FAULT).
      In v2.0, output IDs are auto-assigned.

  check-staleness:
    type: boolean
    description: Enable staleness detection

  stale-timeout-us:
    type: int
    description: Staleness timeout in microseconds

  check-range:
    type: boolean
    description: Enable range checking

  min-value:
    type: int
    description: Minimum valid value

  max-value:
    type: int
    description: Maximum valid value

  check-status:
    type: boolean
    description: Check for FAULT/INCONSISTENT status from merges

  fault-level:
    type: int
    description: |
      Severity level when fault is detected (default: 1)
      0 = No fault (informational)
      1 = Warning / Soft fault
      2 = Error / Medium fault
      3 = Critical / Hard fault
      Higher levels available with LQ_MAX_FAULT_LEVELS config

  wake-function:
    type: string
    description: |
      Name of wake callback function for IMMEDIATE safety response.
      
      Called during event ingestion when range faults are detected on
      RAW hardware values (before any processing, merging, or scaling).
      This provides the fastest possible response for safety-critical
      conditions.
      
      User must implement:
        void function_name(uint8_t monitor_id, 
                          int32_t raw_value,
                          enum lq_fault_level level)
      
      Use for immediate hardware safety actions:
      - Emergency shutdown
      - Power cutoff
      - Hardware brake engagement
      - Safety state transitions
      
      KEEP WAKE FUNCTIONS SHORT AND FAST - just set flags or trigger
      hardware. Complex processing belongs elsewhere.
      
      Note: Only range checks trigger immediate wake. Staleness and
      status checks happen later during full fault processing.

  limp-target-scale-id:
    type: int
    description: |
      Index of scale driver to modify when fault is detected (0-based).
      When specified, enables limp-home mode response. The fault monitor
      will automatically modify this scale driver's parameters when the
      fault is active and restore them when the fault clears.

  limp-scale-factor:
    type: int
    description: |
      Scale factor to use in limp mode (1000 = 1.0x).
      If not specified, normal scale factor is unchanged.
      Use to reduce sensitivity: 500 = half response, 250 = quarter response.

  limp-clamp-max:
    type: int
    description: |
      Maximum output clamp in limp mode.
      If not specified, normal clamp-max is unchanged.
      Use to limit maximum output when faults occur.

  limp-clamp-min:
    type: int
    description: |
      Minimum output clamp in limp mode.
      If not specified, normal clamp-min is unchanged.

  restore-delay-ms:
    type: int
    description: |
      Delay in milliseconds before restoring normal mode after fault
      clears. Prevents oscillation between modes (hysteresis).
      Default: 0 (immediate restore)

  status:
    type: string
    description: "okay" to enable, "disabled" to disable
```

## dts/bindings/layered-queue/lq-gpio-pattern.yaml
```yaml
# SPDX-License-Identifier: Apache-2.0
# GPIO Pattern driver - generates periodic patterns on GPIO pins

description: |
  GPIO Pattern Driver for blinking LEDs and generating periodic patterns.

  This driver can generate various patterns on GPIO pins:
  - Static on/off
  - Simple blink (50% duty cycle)
  - PWM-like patterns with configurable duty cycle
  - Custom bit patterns (up to 32 bits)

  Patterns can be:
  1. Free-running (always active)
  2. Signal-controlled (driven by FMI or other signal sources)

  Common use cases:
  - Status LEDs (heartbeat, error indicators)
  - Simple PWM for brightness control
  - Diagnostic patterns
  - User feedback (button press confirmation)
  - FMI-driven indicators (error conditions, modes)

  Example 1: Simple heartbeat LED (1Hz blink)
    heartbeat_led: heartbeat-led {
      compatible = "lq,gpio-pattern";
      gpios = <&gpiog 13 GPIO_ACTIVE_HIGH>;
      pattern-type = "blink";
      frequency = <1>;
    };

  Example 2: Error indicator with custom pattern (3 quick flashes)
    error_led: error-led {
      compatible = "lq,gpio-pattern";
      gpios = <&gpiog 14 GPIO_ACTIVE_HIGH>;
      pattern-type = "custom";
      pattern-bits = <0b11101110111000000000000000000000>;
      pattern-length = <18>;
      frequency = <10>;
    };

  Example 3: PWM-like brightness control (20% duty cycle at 1kHz)
    dim_led: dim-led {
      compatible = "lq,gpio-pattern";
      gpios = <&gpiog 15 GPIO_ACTIVE_HIGH>;
      pattern-type = "pwm";
      frequency = <1000>;
      duty-cycle = <20>;
    };

  Example 4: Signal-controlled LED (driven by FMI)
    fault_led: fault-led {
      compatible = "lq,gpio-pattern";
      gpios = <&gpioa 5 GPIO_ACTIVE_HIGH>;
      pattern-type = "blink";
      frequency = <2>;
      control-signal = <&fault_monitor>;
    };

compatible: "lq,gpio-pattern"

properties:
  gpios:
    type: phandle-array
    required: true
    description: |
      GPIO specification for the output pin.
      Example: gpios = <&gpiog 13 GPIO_ACTIVE_HIGH>;

  pattern-type:
    type: string
    required: false
    default: "blink"
    enum:
      - "static"
      - "blink"
      - "pwm"
      - "custom"
    description: |
      Pattern type:
      - static: Always on (no pattern)
      - blink: 50% duty cycle square wave
      - pwm: Configurable duty cycle (use with duty-cycle property)
      - custom: User-defined bit pattern (use with pattern-bits/pattern-length)

  frequency:
    type: int
    required: false
    default: 1
    description: |
      Pattern frequency in Hz.
      For blink: how many times per second LED toggles
      For PWM: PWM frequency
      For custom: how fast to cycle through pattern bits

      Common values:
      - 0.5 Hz = slow heartbeat (2 second period)
      - 1 Hz = normal heartbeat
      - 2-5 Hz = attention-grabbing blink
      - 100-1000 Hz = PWM for brightness control

  period-us:
    type: int
    required: false
    description: |
      Alternative to frequency: specify period in microseconds.
      If both frequency and period-us are specified, period-us takes precedence.

      period_us = 1000000 / frequency_hz

  duty-cycle:
    type: int
    required: false
    default: 50
    description: |
      Duty cycle percentage (0-100) for PWM patterns.
      Only used when pattern-type = "pwm".

      - 0 = always off
      - 50 = 50% on (default for blink)
      - 100 = always on

  pattern-bits:
    type: int
    required: false
    description: |
      Custom bit pattern (32-bit integer, LSB first).
      Only used when pattern-type = "custom".

      Each bit represents one state in the pattern sequence:
      - 0 = LED off
      - 1 = LED on

      Example: 0b10101010 = alternating on/off (8 bits)
      Example: 0b11100000 = 3 quick flashes then pause (8 bits)

  pattern-length:
    type: int
    required: false
    description: |
      Number of bits in custom pattern (1-32).
      Required when pattern-type = "custom".

      Pattern will repeat after pattern-length bits.

  control-signal:
    type: phandle
    required: false
    description: |
      Optional signal phandle to control pattern enable.
      When specified, the pattern is only active when signal value is non-zero.

      This allows FMI or other drivers to control pattern generation:
      - signal value = 0: pattern disabled (LED off)
      - signal value != 0: pattern enabled

      Example: control-signal = <&fault_monitor>;

  inverted:
    type: boolean
    required: false
    description: |
      Invert output signal.
      Useful when GPIO is active-low.

  enabled:
    type: boolean
    required: false
    default: true
    description: |
      Pattern generation enabled at startup.
      Can be disabled to start with LED off.
```

## dts/bindings/layered-queue/lq-limp-home.yaml
```yaml
# SPDX-License-Identifier: Apache-2.0
# Limp-home mode controller - safety degradation

description: |
  Safety controller that monitors fault signals and dynamically adjusts
  scale driver parameters to limit system output when faults are detected.
  
  Limp-home mode is a critical safety feature where the system continues
  operating in a degraded state rather than shutting down completely.
  
  This driver monitors one or more fault signals and when faults exceed
  a threshold, it modifies scale driver parameters to:
    - Reduce maximum output (lower clamp-max)
    - Limit sensitivity (reduce scale-factor)
    - Prevent dangerous outputs while maintaining basic functionality
  
  Common use cases:
    - Reduce motor power on temperature faults
    - Limit steering angle on sensor disagreement
    - Cap throttle response when battery voltage is low
    - Multi-level degradation (warning → error → critical)
  
  The driver modifies scale contexts in real-time, allowing normal
  operation when healthy and automatic degradation on faults.
  
  Example: Temperature-based power limiting
    Normal: scale-factor=1000, clamp-max=2000 (100% throttle, 200% boost)
    Limp:   scale-factor=500,  clamp-max=1000 (50% throttle, 100% max)

compatible: "lq,limp-home"

properties:
  fault-signal-id:
    type: int
    required: true
    description: |
      Signal ID to monitor for faults. This is typically the output
      of a fault monitor. Non-zero values indicate fault condition.

  fault-threshold:
    type: int
    required: false
    description: |
      Fault level that triggers limp-home mode. When fault signal
      value >= threshold, limp mode activates.
      Default: 1 (any fault triggers limp mode)

  target-scale-id:
    type: int
    required: true
    description: |
      Index of the scale driver to modify (0-based index into
      engine's scales array). This scale's parameters will be
      overridden when limp mode is active.

  limp-scale-factor:
    type: int
    required: false
    description: |
      Scale factor to use in limp mode (1000 = 1.0x).
      If not specified, normal scale factor is unchanged.

  limp-clamp-max:
    type: int
    required: false
    description: |
      Maximum output clamp in limp mode.
      If not specified, normal clamp-max is unchanged.

  limp-clamp-min:
    type: int
    required: false
    description: |
      Minimum output clamp in limp mode.
      If not specified, normal clamp-min is unchanged.

  restore-delay-ms:
    type: int
    required: false
    description: |
      Delay in milliseconds before restoring normal mode after fault
      clears. Prevents oscillation between modes.
      Default: 0 (immediate restore)
```

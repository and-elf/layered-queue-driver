## dts/bindings/layered-queue/lq,protocol-isotp.yaml
```yaml
# Copyright (c) 2026 Layered Queue Driver
# SPDX-License-Identifier: Apache-2.0

description: |
  ISO-TP (ISO 15765-2) Transport Protocol Driver
  
  Implements ISO Transport Protocol for CAN, providing segmentation
  and reassembly for messages longer than 8 bytes.
  
  Features:
  - Single frame (SF): ≤7 bytes
  - Multi-frame: First Frame (FF) + Consecutive Frames (CF)
  - Flow Control (FC): CTS/WAIT/OVERFLOW
  - Configurable timing parameters (N_As, N_Ar, N_Bs, N_Cr)
  - Block size and STmin support
  
  Commonly used for UDS diagnostic protocols, firmware updates,
  and other protocols requiring reliable message transfer.

compatible: "lq,protocol-isotp"

properties:
  can-id-request:
    type: int
    required: true
    description: |
      CAN ID for incoming diagnostic requests (tester -> ECU).
      Standard diagnostic IDs:
      - 0x7DF: Functional (broadcast to all ECUs)
      - 0x7E0-0x7E7: Physical (specific ECU)
      - 0x18DA00F1: Extended J1939 diagnostic

  can-id-response:
    type: int
    required: true
    description: |
      CAN ID for outgoing diagnostic responses (ECU -> tester).
      Standard response IDs:
      - 0x7E8-0x7EF: Physical response (request + 0x08)
      - 0x18DAF100: Extended J1939 response

  rx-buffer-size:
    type: int
    default: 256
    description: |
      Receive buffer size in bytes.
      Must be large enough for longest expected message.
      Typical sizes:
      - 256: Standard UDS requests
      - 4096: Firmware download

  tx-buffer-size:
    type: int
    default: 256
    description: |
      Transmit buffer size in bytes.
      Typical sizes:
      - 256: Standard UDS responses
      - 4096: Firmware upload

  block-size:
    type: int
    default: 0
    description: |
      Flow control block size (0-255).
      Number of consecutive frames before requiring FC.
      0 = No blocking (send all CF without intermediate FC)

  stmin-us:
    type: int
    default: 0
    description: |
      Minimum separation time between consecutive frames (µs).
      Range:
      - 0-127000: Microseconds (1ms steps for 0-127)
      - 100-900: Microseconds (100µs steps for 0xF1-0xF9)

  n-as-timeout-ms:
    type: int
    default: 1000
    description: |
      N_As timeout: Maximum time to wait for sender to start
      transmitting after FC CTS (ms).

  n-ar-timeout-ms:
    type: int
    default: 1000
    description: |
      N_Ar timeout: Maximum time to wait for receiver to send
      Flow Control after First Frame (ms).

  n-bs-timeout-ms:
    type: int
    default: 1000
    description: |
      N_Bs timeout: Maximum time between consecutive frames
      within a block (ms).

  n-cr-timeout-ms:
    type: int
    default: 1000
    description: |
      N_Cr timeout: Maximum time to wait for consecutive frame
      after previous one (ms).

  extended-addressing:
    type: boolean
    default: false
    description: |
      Enable ISO-TP extended addressing.
      If true, first data byte is target address.

  target-address:
    type: int
    description: |
      Target address for extended addressing mode.
      Required if extended-addressing is true.

  padding:
    type: boolean
    default: false
    description: |
      Enable CAN frame padding to 8 bytes.
      Recommended for some automotive networks.

  padding-byte:
    type: int
    default: 0xCC
    description: |
      Byte value used for padding (if enabled).
      Common values:
      - 0x00: Zero padding
      - 0xCC: ISO-TP standard
      - 0xFF: Alternative padding
```

## dts/bindings/layered-queue/lq,protocol-j1939.yaml
```yaml
# Copyright (c) 2026 Layered Queue Driver
# SPDX-License-Identifier: Apache-2.0

description: |
  J1939 Protocol Driver - SAE J1939 CAN protocol support
  
  Implements bidirectional J1939 protocol handling:
  - Decode: Parses incoming J1939 PGNs to internal signals
  - Encode: Formats internal signals to outgoing J1939 messages
  
  Supports standard PGNs (EEC1, ET1, DM1, etc.) with configurable
  cyclic transmission and on-change updates.

compatible: "lq,protocol-j1939"

properties:
  node-address:
    type: int
    required: true
    description: |
      J1939 source address for this node (0-253).
      Common ranges:
      - 0-127: Preferred addresses
      - 128-247: Self-configurable
      - 248-253: Industry-specific
      - 254: NULL address
      - 255: Global/broadcast

  priority:
    type: int
    default: 6
    description: |
      Default CAN priority for transmitted messages (0-7).
      0 = highest priority, 7 = lowest.

  mtu:
    type: int
    default: 8
    description: |
      Maximum Transmission Unit in bytes.
      J1939 uses 8 bytes (standard CAN).
      For CAN-FD, can be 64 bytes.

  mtu:
    type: int
    default: 8
    description: |
      Maximum Transmission Unit in bytes.
      J1939 uses 8 bytes (standard CAN).
      For CAN-FD, can be 64 bytes.

child-binding:
  description: PGN decode/encode mappings

  properties:
    pgn:
      type: int
      required: true
      description: |
        J1939 Parameter Group Number (PGN).
        Standard PGNs:
        - 65265 (0xFEF1): EEC1 - Engine Controller
        - 65262 (0xFEEE): ET1 - Engine Temperature
        - 65226 (0xFECA): DM1 - Active DTCs
        - 65227 (0xFECB): DM2 - Previously Active DTCs

    direction:
      type: string
      required: true
      enum: ["rx", "tx", "both"]
      description: |
        Message direction:
        - rx: Receive only (decode to signals)
        - tx: Transmit only (encode from signals)
        - both: Bidirectional

    signal-ids:
      type: array
      required: true
      description: |
        Array of signal IDs associated with this PGN.
        Order matters - signals map to PGN byte layout.
        
        For EEC1 example:
        - signal-ids[0] = Engine RPM
        - signal-ids[1] = Engine Torque

    period-ms:
      type: int
      default: 0
      description: |
        Cyclic transmission period in milliseconds (TX only).
        0 = on-change transmission only.
        Common periods:
        - 10ms: Critical control signals
        - 50ms: Normal engine data
        - 100ms: Auxiliary data
        - 1000ms: Diagnostic data

    on-change:
      type: boolean
      default: false
      description: |
        Transmit message when signal values change (TX only).
        Can be combined with cyclic transmission.

    scaling:
      type: array
      description: |
        Optional scaling factors for each signal.
        Array of objects with:
        - multiplier: float
        - offset: int
        Example: J1939 RPM = value * 0.125

    timeout-ms:
      type: int
      default: 0
      description: |
        Reception timeout in milliseconds (RX only).
        If no message received within timeout, signals marked stale.
        0 = no timeout checking.
```

## dts/bindings/layered-queue/lq,protocol-uds.yaml
```yaml
# Copyright (c) 2026 Layered Queue Driver
# SPDX-License-Identifier: Apache-2.0

description: |
  UDS (Unified Diagnostic Services) Protocol Driver - ISO 14229
  
  Implements automotive diagnostic services for ECU diagnostics,
  configuration, and programming.
  
  Supported Services:
  - 0x10: Diagnostic Session Control
  - 0x22: Read Data By Identifier
  - 0x2E: Write Data By Identifier
  - 0x27: Security Access
  - 0x31: Routine Control
  - 0x3E: Tester Present
  
  Features:
  - Multi-level security access with seed/key
  - Session timeout management (S3)
  - Custom DID handlers for application data
  - Negative Response Code (NRC) generation
  
  Typically runs over ISO-TP transport layer.

compatible: "lq,protocol-uds"

properties:
  isotp:
    type: phandle
    required: true
    description: |
      Reference to ISO-TP transport layer node.
      UDS messages are transported over ISO-TP.

  max-security-level:
    type: int
    default: 3
    description: |
      Maximum security level supported (0-3).
      Levels:
      - 0: Locked (no access)
      - 1: Basic access (read-only)
      - 2: Extended access (read/write config)
      - 3: Programming access (flash operations)

  default-session:
    type: int
    default: 1
    description: |
      Default diagnostic session (0x10 service).
      Sessions:
      - 1: Default session
      - 2: Programming session
      - 3: Extended diagnostic session
      - 4: Safety system diagnostic session

  s3-timeout-ms:
    type: int
    default: 5000
    description: |
      S3 server timeout (ms).
      Maximum time between tester present messages before
      returning to default session.
      Standard: 5000ms

  p2-timeout-ms:
    type: int
    default: 50
    description: |
      P2 server timeout (ms).
      Maximum time for server to start response transmission.
      Standard: 50ms

  p2-star-timeout-ms:
    type: int
    default: 5000
    description: |
      P2* enhanced timeout (ms).
      Extended timeout when server sends NRC 0x78 (Pending).
      Standard: 5000ms

  security-lockout-enabled:
    type: boolean
    default: true
    description: |
      Enable security access lockout after failed attempts.
      Prevents brute-force attacks on seed/key algorithm.

  max-security-attempts:
    type: int
    default: 3
    description: |
      Maximum security access attempts before lockout.
      After this many failures, security is locked until
      power cycle or timeout expires.

  security-lockout-time-ms:
    type: int
    default: 60000
    description: |
      Security lockout duration (ms).
      Time before security attempts reset after lockout.
      Standard: 60000ms (1 minute)

  seed-key-algorithm:
    type: string
    enum:
      - "simple-xor"
      - "custom"
    default: "simple-xor"
    description: |
      Seed/key algorithm for security access.
      - simple-xor: key = seed ^ 0xDEADBEEF (testing only!)
      - custom: User-provided callback function
      
      IMPORTANT: simple-xor is NOT secure. Use custom callback
      for production with proper cryptographic algorithm.

  enable-routine-control:
    type: boolean
    default: true
    description: |
      Enable Routine Control service (0x31).
      Required for calibration mode and system tests.

  enable-write-did:
    type: boolean
    default: true
    description: |
      Enable Write Data By Identifier service (0x2E).
      Required for configuration framework.

  enable-read-did:
    type: boolean
    default: true
    description: |
      Enable Read Data By Identifier service (0x22).
      Always enabled for diagnostics.

child-binding:
  description: |
    Data Identifiers (DIDs) for diagnostic data access.
    Each child node defines one or more DIDs.

  properties:
    did:
      type: int
      required: true
      description: |
        Data Identifier (16-bit).
        Standard ranges:
        - 0xF186-0xF19F: Network configuration
        - 0xF1A0-0xF1FF: Application-specific (layered queue config)
        - 0xF100-0xF18F: Vehicle manufacturer specific
        
        Layered Queue DIDs:
        - 0xF1A0: Signal value
        - 0xF1A1: Signal status
        - 0xF1A2: Remap configuration
        - 0xF1A3: Scale configuration
        - 0xF1A6: Calibration mode status

    access:
      type: string
      enum:
        - "read"
        - "write"
        - "read-write"
      default: "read"
      description: |
        DID access permissions.
        - read: Service 0x22 only
        - write: Service 0x2E only
        - read-write: Both services

    security-level:
      type: int
      default: 0
      description: |
        Minimum security level required for access.
        0 = No security needed
        1-3 = Security unlock required

    session-type:
      type: int
      default: 1
      description: |
        Required diagnostic session for access.
        1 = Default session
        3 = Extended diagnostic session

    data-length:
      type: int
      description: |
        Fixed data length for this DID (bytes).
        If omitted, variable length is supported.

    handler:
      type: string
      enum:
        - "config-framework"
        - "custom"
      default: "custom"
      description: |
        DID handler type.
        - config-framework: Uses lq_config DID handlers
        - custom: Application-provided callback
```

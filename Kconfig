## dts/bindings/layered-queue/lq-pid.yaml
```yaml
# SPDX-License-Identifier: Apache-2.0
# PID controller driver binding

description: |
  PID (Proportional-Integral-Derivative) controller for closed-loop control.
  
  Uses measured feedback from verified outputs to maintain a setpoint.
  Calculates control output based on error between setpoint and measurement.
  
  PID equation:
    output = Kp*error + Ki*integral(error) + Kd*derivative(error)
  
  Where:
    error = setpoint - measurement
    Kp = Proportional gain (immediate response to current error)
    Ki = Integral gain (eliminates steady-state error)
    Kd = Derivative gain (dampens oscillation, predicts future error)
  
  Common applications:
  - Temperature control (heater power based on temp error)
  - Motor speed control (throttle based on speed error)
  - Position control (valve position based on position error)
  - Pressure control (pump speed based on pressure error)
  
  Typical PID tuning:
  - Start with Kp only, increase until oscillation
  - Add Ki to eliminate offset, keep small to avoid overshoot
  - Add Kd to dampen oscillation, use sparingly (sensitive to noise)
  
  Anti-windup:
  - Integral term clamped to prevent runaway
  - Important when output saturates (can't go higher/lower)

compatible: "lq,pid-controller"

properties:
  setpoint:
    type: phandle
    description: |
      (v2.0 - PREFERRED) Setpoint source node phandle (desired value).
      Example: setpoint = <&temp_setpoint>;

  measurement:
    type: phandle
    description: |
      (v2.0 - PREFERRED) Measurement feedback node phandle (actual value).
      Example: measurement = <&temp_sensor>;
      Usually comes from a verified output or sensor.

  setpoint-signal-id:
    type: int
    required: false
    description: |
      (v1.x - DEPRECATED) Setpoint signal ID (desired value).
      Use 'setpoint' phandle property instead for v2.0.

  measurement-signal-id:
    type: int
    required: false
    description: |
      (v1.x - DEPRECATED) Measurement signal ID (actual value).
      Use 'measurement' phandle property instead for v2.0.

  output-signal-id:
    type: int
    required: false
    description: |
      (v1.x - DEPRECATED) Output signal ID for PID result.
      In v2.0, output IDs are auto-assigned.

properties:
  setpoint-signal-id:
    type: int
    required: true
    description: |
      Signal ID for desired setpoint (target value).
      Example: Desired temperature = 75°C

  measurement-signal-id:
    type: int
    required: true
    description: |
      Signal ID for measured feedback (actual value).
      Example: Actual temperature from sensor = 72°C
      
      Typically comes from verified-output or direct sensor.

  output-signal-id:
    type: int
    required: true
    description: |
      Signal ID for PID control output.
      This value drives the actuator to reach setpoint.
      Example: Heater power = 0-1000 (0-100%)

  kp:
    type: int
    required: true
    description: |
      Proportional gain (scaled by 1000).
      
      Multiplies current error: output += Kp * error
      - Higher Kp = faster response but more overshoot
      - Too high = oscillation
      
      Fixed-point: kp=1000 means Kp=1.0, kp=500 means Kp=0.5
      Example: kp=2000 (Kp=2.0)

  ki:
    type: int
    required: false
    description: |
      Integral gain (scaled by 1000).
      
      Accumulates error over time: output += Ki * sum(error)
      - Eliminates steady-state offset
      - Too high = overshoot and slow settling
      
      Fixed-point: ki=100 means Ki=0.1
      Default: 0 (integral disabled)

  kd:
    type: int
    required: false
    description: |
      Derivative gain (scaled by 1000).
      
      Responds to rate of change: output += Kd * d(error)/dt
      - Dampens oscillation
      - Predicts future error
      - Sensitive to measurement noise
      
      Fixed-point: kd=500 means Kd=0.5
      Default: 0 (derivative disabled)

  output-min:
    type: int
    required: true
    description: |
      Minimum PID output value (clamp floor).
      Example: 0 for heater (can't cool)

  output-max:
    type: int
    required: true
    description: |
      Maximum PID output value (clamp ceiling).
      Example: 1000 for 100% power

  integral-min:
    type: int
    required: false
    description: |
      Minimum integral accumulator (anti-windup floor).
      Prevents integral from winding down excessively.
      Default: -1000000

  integral-max:
    type: int
    required: false
    description: |
      Maximum integral accumulator (anti-windup ceiling).
      Prevents integral from winding up excessively.
      Default: 1000000

  deadband:
    type: int
    required: false
    description: |
      Error deadband for integral term.
      
      If |error| <= deadband, integral stops accumulating.
      Prevents integral windup when close to setpoint.
      
      Example: deadband=10 means ±1°C around setpoint doesn't accumulate
      Default: 0 (no deadband)

  sample-time-us:
    type: int
    required: false
    description: |
      Fixed sample time for derivative and integral calculations (microseconds).
      
      If not specified, uses actual time delta (variable dt).
      Fixed sample time can improve stability with variable timing.
      
      Default: 0 (use actual dt)

  reset-on-setpoint-change:
    type: boolean
    description: |
      Reset integral term when setpoint changes.
      
      true: Prevents integral from fighting new setpoint
      false: Keeps integral history across setpoint changes
      
      Default: true

  status:
    type: string
    description: "okay" to enable, "disabled" to disable
```

## dts/bindings/layered-queue/lq-remap.yaml
```yaml
# SPDX-License-Identifier: Apache-2.0
# Remap driver - maps input signals to named functions

description: |
  Remaps input signals to logical function names.
  
  This driver allows you to decouple hardware inputs from their logical
  purpose. For example, you might remap a joystick X-axis (hardware signal)
  to a "steering" function, or a trigger button to "throttle".
  
  The function-name is purely for documentation and DTS clarity - the actual
  signal routing uses signal IDs. However, this makes configurations much
  more readable and maintainable.
  
  Example use case:
    joystick_x (signal 0) -> remap -> "steering" function (signal 10)
    joystick_y (signal 1) -> remap -> "throttle" function (signal 11)
    button_a (signal 2) -> remap -> "fire" function (signal 12)

compatible: "lq,remap"

properties:
  input:
    type: phandle
    description: |
      (v2.0 - PREFERRED) Input source node phandle to remap.
      Example: input = <&joystick_x>;

  input-signal-id:
    type: int
    required: false
    description: |
      (v1.x - DEPRECATED) Source signal ID to remap.
      Use 'input' phandle property instead for v2.0.

  output-signal-id:
    type: int
    required: false
    description: |
      (v1.x - DEPRECATED) Output signal ID.
      In v2.0, output IDs are auto-assigned.
    description: Destination signal ID (the remapped function)

  function-name:
    type: string
    required: false
    description: |
      Human-readable name for this function (e.g., "steering", "throttle").
      This is for documentation purposes and doesn't affect code generation.

  invert:
    type: boolean
    required: false
    description: |
      If true, invert the signal value (multiply by -1).
      Useful for reversing joystick axes.

  deadzone:
    type: int
    required: false
    description: |
      Deadzone threshold in raw units. Values within ±deadzone of zero
      will be clamped to zero. Useful for eliminating joystick drift.
      Default: 0 (no deadzone)
```

## dts/bindings/layered-queue/lq-scale.yaml
```yaml
# SPDX-License-Identifier: Apache-2.0
# Scale driver - applies linear transformation to signals

description: |
  Applies a scale factor and offset to input signals.
  
  This driver performs the transformation:
    output = (input * scale / 1000) + offset
  
  The scale factor uses fixed-point with 1000 = 1.0, so:
    - scale = 1000 means 1.0x (no scaling)
    - scale = 2000 means 2.0x (double)
    - scale = 500 means 0.5x (half)
    - scale = -1000 means -1.0x (invert)
  
  Common use cases:
    - Convert ADC counts to engineering units
    - Normalize joystick range (-32768 to 32767) to percentage (-1000 to 1000)
    - Apply sensitivity adjustments to user controls
    - Convert between different units (RPM to Hz, etc.)
  
  Example: Joystick normalization
    Input: -32768 to 32767 (16-bit ADC)
    scale = 31  (approximately 1000/32)
    offset = 0
    Output: -1000 to 1000 (normalized percentage)

compatible: "lq,scale"

properties:
  source:
    type: phandle
    description: |
      (v2.0 - PREFERRED) Source node phandle to scale.
      Example: source = <&temp_adc>;
      
      This is the recommended way to reference signals in v2.0.

  input:
    type: phandle
    description: |
      (v2.0 - ALTERNATIVE) Alias for 'source' property.
      Some nodes may prefer 'input' for semantic clarity.

  input-signal-id:
    type: int
    required: false
    description: |
      (v1.x - DEPRECATED) Source signal ID to scale.
      Use 'source' phandle property instead for v2.0.

  output-signal-id:
    type: int
    required: false
    description: |
      (v1.x - DEPRECATED) Destination signal ID (scaled result).
      In v2.0, output IDs are auto-assigned.

  scale-factor:
    type: int
    required: true
    description: |
      Scale multiplier in fixed-point (1000 = 1.0).
      Can be negative for inversion.

  offset:
    type: int
    required: false
    description: |
      Value to add after scaling. In same units as output.
      Default: 0

  clamp-min:
    type: int
    required: false
    description: |
      Minimum output value (clamping). If specified, output will be
      clamped to this minimum. Useful for limiting control ranges.

  clamp-max:
    type: int
    required: false
    description: |
      Maximum output value (clamping). If specified, output will be
      clamped to this maximum. Useful for limiting control ranges.
```

## dts/bindings/layered-queue/lq-verified-output.yaml
```yaml
# SPDX-License-Identifier: Apache-2.0
# Verified output driver binding

description: |
  Verified output driver that commands hardware and verifies the output
  actually occurred by reading back a verification signal.
  
  Critical safety feature: Don't just command hardware - VERIFY it happened.
  If commanded output doesn't match verification within tolerance and timeout,
  sets fault status for safety response.
  
  Use cases:
  - GPIO: Command pin, verify with readback or separate verification pin
  - PWM: Command duty cycle, measure actual duty/frequency
  - Relay/Solenoid: Command state, verify position switch
  - Motor: Command speed, verify with encoder/tachometer
  - Valve: Command position, verify with position sensor
  
  Verification methods:
  1. Direct readback: Read same output pin/register
  2. Separate sensor: Different physical verification pin/signal
  3. Measured feedback: Analog measurement of actual output
  
  On verification failure:
  - Sets output signal status to FAULT
  - Can trigger fault monitor / limp-home
  - Provides measured value for closed-loop control (PID)

compatible: "lq,verified-output"

properties:
  command:
    type: phandle
    description: |
      (v2.0 - PREFERRED) Command source node phandle.
      Example: command = <&pid_output>;
      This is what we want the output to be.

  verification:
    type: phandle
    description: |
      (v2.0 - PREFERRED) Verification feedback node phandle.
      Example: verification = <&position_sensor>;
      This is what the output actually is (measured).

  command-signal-id:
    type: int
    required: false
    description: |
      (v1.x - DEPRECATED) Command signal ID.
      Use 'command' phandle property instead for v2.0.

  verification-signal-id:
    type: int
    required: false
    description: |
      (v1.x - DEPRECATED) Verification signal ID.
      Use 'verification' phandle property instead for v2.0.

  output-signal-id:
    type: int
    required: false
    description: |
      (v1.x - DEPRECATED) Output signal ID for verified result.
      In v2.0, output IDs are auto-assigned.

properties:
  command-signal-id:
    type: int
    required: true
    description: |
      Signal ID containing the desired output command value.
      This is what you WANT the output to be.

  verification-signal-id:
    type: int
    required: true
    description: |
      Signal ID containing the measured/verified actual output value.
      This is what the output ACTUALLY is (read from hardware).
      
      For GPIO: Could be same signal (readback) or different (verify pin)
      For PWM: Measured duty cycle or frequency
      For motors: Encoder feedback
      For valves: Position sensor

  output-signal-id:
    type: int
    required: true
    description: |
      Signal ID for the verified output status and value.
      
      Value: Actual measured output (from verification-signal)
      Status: OK if verified, FAULT if mismatch detected
      
      This signal can feed into fault monitors or PID controllers.

  output-type:
    type: string
    required: true
    description: |
      Type of output hardware being verified.
      - "gpio": Digital output (0/1)
      - "pwm": PWM duty cycle (0-1000 = 0-100%)
      - "analog": Analog output voltage/current
      - "position": Linear/rotary position
      - "speed": Motor speed (RPM, rad/s, etc.)
    enum:
      - gpio
      - pwm
      - analog
      - position
      - speed

  tolerance:
    type: int
    required: false
    description: |
      Maximum allowed difference between command and verification.
      
      For GPIO: Must be 0 (exact match)
      For PWM: Duty cycle tolerance (e.g., 50 = ±5%)
      For analog: Voltage/current tolerance
      For position: Position error tolerance
      
      If |command - verification| > tolerance, status = FAULT
      Default: 0 (exact match)

  verification-timeout-us:
    type: int
    required: false
    description: |
      Maximum time to wait for verification after commanding output.
      Some outputs (relays, valves) take time to actuate.
      
      Verification is checked AFTER this timeout expires.
      If still mismatched, status = FAULT
      
      Default: 0 (immediate verification)

  continuous-verify:
    type: boolean
    description: |
      Enable continuous verification monitoring.
      
      true: Continuously check verification matches command (e.g., GPIO)
      false: Only verify once after timeout (e.g., slow valves)
      
      Default: true

  gpio-verify-pin:
    type: int
    description: |
      For GPIO verification: Separate verification pin number.
      If not specified, reads back same pin that was commanded.
      
      Use separate pin when:
      - Hardware has position switch distinct from command output
      - Want to verify through independent circuit path

  pwm-measure-type:
    type: string
    description: |
      For PWM verification: What to measure
      - "duty": Measure duty cycle percentage (0-1000)
      - "frequency": Measure frequency in Hz
      - "both": Verify both duty and frequency
    enum:
      - duty
      - frequency
      - both

  status:
    type: string
    description: "okay" to enable, "disabled" to disable
```

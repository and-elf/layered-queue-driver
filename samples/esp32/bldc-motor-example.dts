/ {
    compatible = "layered-queue,example";
    
    /* 3-Phase BLDC Motor Configuration for ESP32 */
    bldc_motor: bldc@0 {
        compatible = "lq,bldc-motor";
        label = "MAIN_MOTOR";
        motor-id = <0>;
        
        /* Motor electrical configuration */
        num-phases = <3>;
        pole-pairs = <7>;  /* Common for drone/RC motors */
        
        /* Commutation mode */
        mode = "sine";  /* Options: "6step", "sine", "foc", "open-loop" */
        
        /* PWM configuration */
        pwm-frequency-hz = <25000>;  /* 25kHz */
        max-duty-cycle = <9500>;     /* 95% (0.01% resolution) */
        
        /* Deadtime for complementary outputs */
        enable-deadtime;
        deadtime-ns = <1000>;  /* 1μs */
        
        /* ESP32 MCPWM Pin Configuration */
        /* High-side pins: [port, pin, AF] - AF unused on ESP32 */
        high-side-pins = <
            0 16 0   /* GPIO16 = MCPWM0A (Phase U) */
            0 18 0   /* GPIO18 = MCPWM1A (Phase V) */
            0 19 0   /* GPIO19 = MCPWM2A (Phase W) */
        >;
        
        /* Low-side (complementary) pins: [port, pin, AF] */
        low-side-pins = <
            0 17 0   /* GPIO17 = MCPWM0B (Phase U complementary) */
            0  5 0   /* GPIO5  = MCPWM1B (Phase V complementary) */
            0  4 0   /* GPIO4  = MCPWM2B (Phase W complementary) */
        >;
        
        status = "okay";
    };
    
    /* Example: Dual motor configuration (ESP32 has 2 MCPWM units) */
    bldc_motor1: bldc@1 {
        compatible = "lq,bldc-motor";
        label = "MOTOR_2";
        motor-id = <1>;
        
        num-phases = <3>;
        pole-pairs = <14>;
        mode = "sine";
        pwm-frequency-hz = <32000>;
        max-duty-cycle = <9800>;
        enable-deadtime;
        deadtime-ns = <800>;
        
        /* MCPWM1 pins (second motor) */
        high-side-pins = <
            0 25 0   /* GPIO25 = MCPWM0A on UNIT1 */
            0 26 0   /* GPIO26 = MCPWM1A on UNIT1 */
            0 27 0   /* GPIO27 = MCPWM2A on UNIT1 */
        >;
        
        low-side-pins = <
            0 32 0   /* GPIO32 = MCPWM0B on UNIT1 */
            0 33 0   /* GPIO33 = MCPWM1B on UNIT1 */
            0 14 0   /* GPIO14 = MCPWM2B on UNIT1 */
        >;
        
        status = "okay";
    };
    
    /* Example: Throttle input from ADC */
    throttle: analog-input@0 {
        compatible = "lq,analog-input";
        label = "THROTTLE";
        channel = <0>;
        
        /* Scale ADC (0-4095) to throttle (0-100) */
        input-scale = "linear";
        input-min = <0>;
        input-max = <4095>;
        output-min = <0>;
        output-max = <100>;
        
        /* Safety: require valid signal */
        fault-timeout-ms = <100>;
        default-value = <0>;  /* Stop on fault */
        
        status = "okay";
    };
};

/*
 * SAMD BLDC Motor Example Device Tree
 * 
 * Hardware: SAMD21/SAMD51
 * TCC0 with 3-phase complementary PWM outputs
 */

/ {
    /* Single BLDC motor on TCC0 */
    motor0: bldc-motor@0 {
        compatible = "lq,bldc-motor";
        motor-id = <0>;
        num-phases = <3>;
        pole-pairs = <7>;
        pwm-frequency-hz = <25000>;
        mode = "sine";
        max-duty-cycle = <9500>;    /* 95% */
        enable-deadtime;
        deadtime-ns = <1000>;       /* 1 microsecond */
        
        /* TCC0 Pin Configuration (SAMD21/SAMD51)
         * Format: [gpio_port, gpio_pin, peripheral_function]
         * 
         * PORTA = 0, PORTB = 1
         * Peripheral functions:
         *   E = 0x04 (TCC0/TCC1)
         *   F = 0x05 (TCC0/TCC1 alternate)
         */
        high-side-pins = <
            0  4  0x04  /* PA04 = TCC0/WO[0] (Phase U) */
            0  5  0x04  /* PA05 = TCC0/WO[1] (Phase V) */
            0  6  0x04  /* PA06 = TCC0/WO[2] (Phase W) */
        >;
        
        low-side-pins = <
            0  10  0x04  /* PA10 = TCC0/WO[4] (Phase U_N) */
            0  11  0x04  /* PA11 = TCC0/WO[5] (Phase V_N) */
            0  12  0x04  /* PA12 = TCC0/WO[6] (Phase W_N) */
        >;
        
        status = "okay";
    };
    
    /* Throttle input (ADC) */
    throttle: lq-hw-adc-input@0 {
        compatible = "lq,hw-adc-input";
        signal-id = <0>;
        adc-channel = <0>;          /* ADC0 = AIN0 (PA02 on SAMD21) */
        stale-us = <10000>;
    };
};

/*
 * Alternative Pin Configurations for Different SAMD Boards
 * 
 * SAMD21 Arduino Zero / MKR:
 * ==========================
 * High-side:
 *   PA04 = TCC0/WO[0] (D2)
 *   PA05 = TCC0/WO[1] (D3)
 *   PA06 = TCC0/WO[2] (D4)
 * 
 * Low-side:
 *   PA10 = TCC0/WO[4] (D1/TX)
 *   PA11 = TCC0/WO[5] (D0/RX)
 *   PA12 = TCC0/WO[6] (MOSI)
 * 
 * SAMD51 Adafruit Metro M4:
 * =========================
 * High-side:
 *   PB12 = TCC0/WO[0] (D10)
 *   PB13 = TCC0/WO[1] (D11)
 *   PA20 = TCC0/WO[2] (D12)
 * 
 * Low-side:
 *   PA14 = TCC0/WO[4] (D2)
 *   PA15 = TCC0/WO[5] (D3)
 *   PA16 = TCC0/WO[6] (D4)
 * 
 * SAMD51 Dual Motor Example (TCC0 + TCC1):
 * =========================================
 */

/ {
    /* Motor 0 on TCC0 (same as above) */
    
    /* Motor 1 on TCC1 (SAMD51 only) */
    motor1: bldc-motor@1 {
        compatible = "lq,bldc-motor";
        motor-id = <1>;
        num-phases = <3>;
        pole-pairs = <7>;
        pwm-frequency-hz = <25000>;
        mode = "sine";
        enable-deadtime;
        deadtime-ns = <1000>;
        
        /* TCC1 Pin Configuration (SAMD51)
         * Function F = 0x05 for TCC1
         */
        high-side-pins = <
            0  16  0x05  /* PA16 = TCC1/WO[0] */
            0  17  0x05  /* PA17 = TCC1/WO[1] */
            0  18  0x05  /* PA18 = TCC1/WO[2] */
        >;
        
        low-side-pins = <
            1  10  0x05  /* PB10 = TCC1/WO[4] */
            1  11  0x05  /* PB11 = TCC1/WO[5] */
            0  19  0x05  /* PA19 = TCC1/WO[6] */
        >;
        
        status = "okay";
    };
};
